## west.yml
```
manifest:
  version: "0.12"

  remotes:
    - name: zephyrproject
      url-base: https://github.com/zephyrproject-rtos

  projects:
    - name: zephyr
      remote: zephyrproject
      revision: v4.3.0
      import: true

  self:
    path: .
```

## prj.conf
```kconfig
# Core subsystems
CONFIG_GPIO=y

# Console via UART
CONFIG_SERIAL=y
CONFIG_CONSOLE=y
CONFIG_UART_CONSOLE=y
CONFIG_UART_INTERRUPT_DRIVEN=y

# tty via UART
CONFIG_CONSOLE_SUBSYS=y
CONFIG_CONSOLE_GETCHAR=y

# LED strip drivers
CONFIG_LED_STRIP=y

# Logging
CONFIG_LOG=y
CONFIG_LOG_DEFAULT_LEVEL=3
```

## src/main.c
```c
#include "drivers/led_color.h"
#include "log/logger.h"
#include "threads_config.h"
#include <zephyr/kernel.h>
LOG_MODULE_REGISTER(main);

int main(void)
{
    LOG_INF("ESP32 demo started");

    while (1)
    {
        // Blink is device alive indicator
        if (led_color_is_blink_allowed() == false)
        {
            k_sleep(K_SECONDS(5));
            led_color_allow_blink();
        }
        else
        {
            led_color_blink_indicator(LED_BLINK_ON);
            k_sleep(K_MSEC(500));
            led_color_blink_indicator(LED_BLINK_OFF);
            k_sleep(K_MSEC(500));
        }
    }

    return 0;
}
```

## src/threads_config.h
```c
#ifndef H_THREADS_CONFIG_H_
#define H_THREADS_CONFIG_H_

#include "uart_console_thread.h"
#include <zephyr/kernel.h>

/* --- Threads configuration --- */
#define UART_STACK_SIZE 1024
#define UART_PRIORITY 5

#define LED_STACK_SIZE 512
#define LED_PRIORITY 10

/* --- Threads definitions --- */
K_THREAD_DEFINE(uart_console_thread_id, UART_STACK_SIZE, uart_console_thread_fn, NULL, NULL, NULL,
                UART_PRIORITY, 0, 0);

#endif /* H_THREADS_CONFIG_H_ */
```
